## config/boards/shields/alik46/Kconfig.defconfig
```kconfig
# Copyright (c) 2022 Duccio Breschi
# SPDX-License-Identifier: MIT

if SHIELD_ALIK46

config ZMK_KEYBOARD_NAME
    default "ALIK46"

endif
```

## config/boards/shields/alik46/Kconfig.shield
```kconfig
# Copyright (c) 2022 Duccio Breschi
# SPDX-License-Identifier: MIT

config SHIELD_ALIK46
    def_bool $(shields_list_contains,ALIK46)
```
